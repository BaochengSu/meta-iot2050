## Kconfig
```kconfig
#
# Copyright (c) Siemens AG, 2021-2023
#
# Authors:
#  Jan Kiszka <jan.kiszka@siemens.com>
#
# This file is subject to the terms and conditions of the MIT License.  See
# COPYING.MIT file in the top-level directory.
#

mainmenu "IOT2050 Image Configuration"

config KAS_BUILD_SYSTEM
	string
	default "isar"

choice
	prompt "Image type"
	default IMAGE_EXAMPLE

config IMAGE_EXAMPLE
	bool "Example image"
	help
	  This is the official example image with several tools as well as
	  Node-RED preinstalled. It comes without a graphical user interface.

config IMAGE_SWUPDATE
	bool "Example image with SWUpdate support"
	help
	  Based on the example image, this adds SWUpdate and changes the
	  partition layout to an A/B rootfs.

config IMAGE_BOOT_PG1
	bool "Firmware image for PG1 devices"
	help
	  Build the firmware image that is responsible for booting Product
	  Generation 1 (PG1) devices.

	  WARNING: Do not flash this image onto your device unless you know
	  that it fits AND you have an external flash programmer at hand that
	  allows to recover. Otherwise you risk to BRICK THE IOT2050!

config IMAGE_BOOT_PG2
	bool "Firmware image for PG2 and M.2 devices"
	help
	  Build the firmware image that is responsible for booting Product
	  Generation 2 (PG2) devices, including its M.2 variant.

	  WARNING: Do not flash this image onto your device unless you know
	  that it fits AND you have an external flash programmer at hand that
	  allows to recover. Otherwise you risk to BRICK THE IOT2050!

endchoice

config KAS_INCLUDE_MAIN
	string
	default "kas-iot2050-example.yml" if IMAGE_EXAMPLE
	default "kas-iot2050-swupdate.yml" if IMAGE_SWUPDATE
	default "kas-iot2050-boot-pg1.yml" if IMAGE_BOOT_PG1
	default "kas-iot2050-boot-pg2.yml" if IMAGE_BOOT_PG2

comment "Image features"

if IMAGE_EXAMPLE || IMAGE_SWUPDATE

config PREEMPT_RT
	bool "Preempt-RT kernel"
	help
	  Build the image with a Preempt-RT kernel, rather than the default
	  non-preemptive one. This can help achieving better real-time
	  latencies with the device.

config KAS_INCLUDE_RT
	string
	default "kas/opt/preempt-rt.yml"
	depends on PREEMPT_RT

config CORAL
	bool "Google Coral Edge TPU support"
	default y
	help
	  Add driver and libraries to use a Google Coral Edge TPU accelerator
	  card if it is installed in the IOT2050 extension slot.

config KAS_INCLUDE_NO_CORAL
	string
	default "kas/opt/no-coral.yml"
	depends on !CORAL

config DOCKER
	bool "Docker support"
	default n
	help
	  Building image with docker support.

config KAS_INCLUDE_DOCKER
	string
	default "kas/opt/docker.yml"
	depends on DOCKER

config LXDE
	bool "LXDE graphical user interface"
	help
	  This adds an LXDE-based graphical user interface.

config KAS_INCLUDE_LXDE
	string
	default "kas/opt/lxde.yml"
	depends on LXDE

endif

# Provide two entries so that the help text can be adjusted to the image.
config SECURE_BOOT
	bool "Secure boot"
	depends on IMAGE_SWUPDATE
	help
	  Enable signing of boot artifacts (boot loader, unified kernel image).
	  Furthermore activate dm-verity integrity protection for the read-only
	  root filesystem.

	  This uses the public custMpk.key and certificate by default. Do not
	  use this key in production, it is for demonstration purposes only.

	  Note: The persistent /var and /home partitions are not yet protected!

config SECURE_BOOT
	bool "Secure boot"
	depends on IMAGE_BOOT_PG2
	help
	  Enable signing of all customizable firmware artifacts, enforce UEFI
	  Secure Boot mode, protect sensitive U-Boot environment variables and
	  prevent interactive access to U-Boot during boot and also on boot
	  failures.

	  This uses the public custMpk.key and certificate by default. Do not
	  use this key in production, it is for demonstration purposes only.

menuconfig OTP_CMD
	bool "OTP Provisioning"
	depends on IMAGE_BOOT_PG2
	help
	  Integrate OTP provisioning data into the firmware artifacts. Various
	  options are avaiable. By default, this will integrate the OTP command
	  data for provision two public key hashes. 

	  WARNING: This uses the dummy keys by default. Do not use these keys
	  in production, they are for demonstration purposes only.

choice
	prompt "*** Secure Boot OTP command type ***"
	depends on OTP_CMD
	default OTP_CMD_PROVISION

config OTP_CMD_PROVISION
	bool "Provision public key hashes"
	help
	  TBD

config OTP_CMD_SWITCH
	bool "Switch to the next key slot"
	help
	  TBD

endchoice

config OTP_ENABLE_SECURE_BOOT
	string "Enable secure boot"
	depends on OTP_CMD && OTP_CMD_PROVISION
	default "n"
	help
	  TBD

comment "Key Configuration"
	depends on OTP_CMD

config OTP_CMD_KEY_1ST
	string "Key for the first slot"
	default "custMpk.pem"
	depends on OTP_CMD
	help
	  The private key used for generating the public key hash that will
	  be included into the OTP command data for the first slot.

	  It must be placed into:
	  * recipes-bsp/secure-boot-otp-provisioning/files/keys/
	  
	  If not required, leave it blank.

config OTP_CMD_KEY_2ND
	string "Key for the second slot"
	default "custSmpk.pem"
	depends on OTP_CMD
	help
	  The private key used for generating the public key hash that will
	  be included into the OTP command data for the second slot.

	  It must be placed into:
	  * recipes-bsp/secure-boot-otp-provisioning/files/keys/

	  If not required, leave it blank.

config OTP_CMD_KEY_3RD
	string "Key for the third slot"
	default ""
	depends on OTP_CMD
	help
	  The private key used for generating the public key hash that will
	  be included into the OTP command data for the third slot.

	  It must be placed into:
	  * recipes-bsp/secure-boot-otp-provisioning/files/keys/

	  If not required, leave it blank.

config OTP_CMD_ACTION
	string
	default "provision" if OTP_CMD_PROVISION
	default "switch" if OTP_CMD_SWITCH
	depends on OTP_CMD

config RPMB_SETUP
	bool "OPTEE RPMB setup for OTP key write"
	depends on IMAGE_BOOT_PG2 && !SECURE_BOOT
	help
	   Enable one-time pairing between processor and secure storage
	   (RPMB on eMMC). Do not sign and distribute this version. Run it
	   only in a secure environment on the target device, then replace it
	   with signed production firmware and enable secure boot.

config KAS_INCLUDE_SECURE_BOOT
	string
	default "kas/opt/secure-boot.yml"
	depends on SECURE_BOOT

config KAS_INCLUDE_OTP_PROVISIONING
	string
	default "kas/opt/otpcmd.yml"
	depends on OTP_CMD

config KAS_INCLUDE_RPMB_SETUP
	string
	default "kas/opt/rpmb-setup.yml"
	depends on RPMB_SETUP

comment "Build options"

config SDK
	bool "Build SDK"
	depends on IMAGE_EXAMPLE || IMAGE_SWUPDATE
	help
	  Generate an SDK consisting of a cross-compiler and library headers
	  needed to build applications for the device.

	  Note: This will not generate the image for the device itself.

config KAS_INCLUDE_SDK
	string
	default "kas/opt/sdk.yml"
	depends on SDK

config PACKAGE_LOCK
	bool "Use Debian packages from release"
	help
	  Use the same Debian packages that were selected for building the
	  released image or firmware version.

config KAS_INCLUDE_PACKAGE_LOCK
	string
	default "kas/opt/package-lock.yml"
	depends on PACKAGE_LOCK

config DEBIAN_MIRROR
	bool "Use specific debian mirror"
	depends on !PACKAGE_LOCK
	help
	  Rather than relying on deb.debian.org to select the best local
	  mirror, specify a specific one.

config DEBIAN_MIRROR_URL
	string "URL of Debian mirror"
	default "http://ftp.de.debian.org"
	depends on DEBIAN_MIRROR

config KAS_INCLUDE_DEBIAN_MIRROR
	string
	default "kas/opt/debian-mirror.yml"
	depends on DEBIAN_MIRROR

config FIRMWARE_SECURE_VER
	string "Use specific firmware secure version"
	default "0"
	depends on SECURE_BOOT && IMAGE_BOOT_PG2
	help
	  Use specific anti-rollback secure version rather than the default 0.
	  Range 0 - 127.
```
